## Kconfig
```kconfig
# SPDX-License-Identifier: MIT
# SPDX-FileCopyrightText: 2026 Steffen Kothe <steffen.kothe@skothe.net>

mainmenu "Quick Yocto Poky Configuration"

config KAS_INCLUDE_MAIN
	string
	default "kas/poky.yaml"

config KAS_BUILD_SYSTEM
	string
	default "openembedded"

source "kas/machine/Kconfig"
source "kas/distro/Kconfig"
source "kas/image/Kconfig"
```

## kas/distro/Kconfig
```kconfig
# SPDX-License-Identifier: MIT
# SPDX-FileCopyrightText: 2026 Steffen Kothe <steffen.kothe@skothe.net>

menu "DISTRO"
choice
	prompt "Distro selection"
	default POKY
config POKY
	bool "Poky Reference Distribution"
endchoice
config KAS_INCLUDE_DISTRO
	string
	default "kas/distro/poky.yaml" if POKY
endmenu
```

## kas/image/Kconfig
```kconfig
# SPDX-License-Identifier: MIT
# SPDX-FileCopyrightText: 2026 Steffen Kothe <steffen.kothe@skothe.net>

menu "IMAGE"

choice
	prompt "Image selection"
	default CORE_IMAGE_MINIMAL

config CORE_IMAGE_MINIMAL 
	bool "Poky core minimal image"

config CORE_IMAGE_FULL_CMDLINE
	bool "Poky full image with command line"

config CORE_IMAGE_MINIMAL_INITRAMFS
	bool "Poky minimal initramfs image"

config CORE_IMAGE_WESTON
	bool "Poky image with weston graphical"

endchoice

config KAS_INCLUDE_IMAGE
	string
	default "kas/image/core-image-minimal.yaml" if CORE_IMAGE_MINIMAL
	default "kas/image/core-image-full-cmdline.yaml" if CORE_IMAGE_FULL_CMDLINE
	default "kas/image/core-image-minimal-initramfs.yaml" if CORE_IMAGE_MINIMAL_INITRAMFS
	default "kas/image/core-image-weston.yaml" if CORE_IMAGE_WESTON
endmenu
```

## kas/machine/Kconfig
```kconfig
# SPDX-License-Identifier: MIT
# SPDX-FileCopyrightText: 2026 Steffen Kothe <steffen.kothe@skothe.net>

menu "MACHINE"
choice
	prompt "Machine selection"
	default QEMU_X86_64

config QEMU_X86_64
	bool "QEMU x86-64"

config QEMU_RISCV_64
	bool "QEMU RISC-V 64"

config QEMU_RISCV_32
	bool "QEMU RISC-V 32"

config QEMU_ARM_64 
	bool "QEMU ARM 64"

config QEMU_ARM 
	bool "QEMU ARM 32"

endchoice
config KAS_INCLUDE_TARGET
	string
	default "kas/machine/qemux86_64.yaml" if QEMU_X86_64
	default "kas/machine/qemuriscv64.yaml" if QEMU_RISCV_64
	default "kas/machine/qemuriscv32.yaml" if QEMU_RISCV_32
	default "kas/machine/qemuarm64.yaml" if QEMU_ARM_64
	default "kas/machine/qemuarm.yaml" if QEMU_ARM
endmenu
```
